/dts-v1/;

/ {

	__fixups__ {
		accdet = "/fragment@6:target:0\0/fragment@42:target:0";
		audgpio = "/fragment@8:target:0";
		auxadc = "/fragment@22:target:0";
		betterlife_platform = "/fragment@21:target:0";
		chosen = "/fragment@0:target:0";
		consys = "/fragment@11:target:0";
		dsi_te = "/fragment@46:target:0";
		fingerprint = "/fragment@48:target:0";
		gpio = "/fragment@37:target:0";
		gpio_usage_mapping = "/fragment@36:target:0";
		gyro = "/fragment@41:target:0";
		i2c0 = "/fragment@24:target:0";
		i2c1 = "/fragment@25:target:0";
		i2c10 = "/fragment@34:target:0";
		i2c11 = "/fragment@35:target:0";
		i2c2 = "/fragment@26:target:0";
		i2c3 = "/fragment@27:target:0";
		i2c4 = "/fragment@28:target:0";
		i2c5 = "/fragment@29:target:0";
		i2c6 = "/fragment@18:target:0\0/fragment@30:target:0";
		i2c7 = "/fragment@31:target:0";
		i2c8 = "/fragment@32:target:0";
		i2c9 = "/fragment@33:target:0";
		irq_nfc = "/fragment@47:target:0";
		irtx_pwm = "/fragment@12:target:0";
		kd_camera_hw1 = "/fragment@60:target:0\0/fragment@64:target:0";
		keypad = "/fragment@62:target:0";
		main_pmic = "/fragment@49:target:0";
		md1_sim1_hot_plug_eint = "/fragment@51:target:0";
		md1_sim2_hot_plug_eint = "/fragment@52:target:0";
		mrdump_ext_rst = "/fragment@38:target:0";
		msdc1_ins = "/fragment@40:target:0";
		mt6370_pmu = "/fragment@14:target:0";
		mt6370_typec = "/fragment@15:target:0";
		mt_pmic_vcama1_ldo_reg = "/fragment@53:target:0\0/fragment@60/__overlay__:vcama_sub-supply:0\0/fragment@64/__overlay__:cam1_vcama-supply:0";
		mt_pmic_vcama2_ldo_reg = "/fragment@54:target:0\0/fragment@60/__overlay__:vcama-supply:0\0/fragment@64/__overlay__:cam0_vcama-supply:0";
		mt_pmic_vcamd_ldo_reg = "/fragment@57:target:0\0/fragment@60/__overlay__:vcamd-supply:0\0/fragment@60/__overlay__:vcamd_sub-supply:0\0/fragment@64/__overlay__:cam0_vcamd-supply:0\0/fragment@64/__overlay__:cam1_vcamd-supply:0";
		mt_pmic_vcamio_ldo_reg = "/fragment@58:target:0\0/fragment@60/__overlay__:vcamio-supply:0\0/fragment@60/__overlay__:vcamio_sub-supply:0\0/fragment@60/__overlay__:vcamio_main2-supply:0\0/fragment@64/__overlay__:cam0_vcamio-supply:0\0/fragment@64/__overlay__:cam1_vcamio-supply:0\0/fragment@64/__overlay__:cam2_vcamio-supply:0\0/fragment@64/__overlay__:cam3_vcamio-supply:0";
		mt_pmic_vldo28_ldo_reg = "/fragment@59:target:0\0/fragment@60/__overlay__:vcamaf-supply:0\0/fragment@60/__overlay__:vcamaf_sub-supply:0\0/fragment@60/__overlay__:vcamaf_main2-supply:0\0/fragment@61/__overlay__:vtouch-supply:0";
		mt_pmic_vsim1_ldo_reg = "/fragment@55:target:0";
		mt_pmic_vsim2_ldo_reg = "/fragment@56:target:0";
		mtkfb = "/fragment@17:target:0";
		odm = "/fragment@1:target:0";
		pio = "/fragment@4:target:0\0/fragment@5/__overlay__/synaptics_tcm@0:interrupt-parent:0\0/fragment@5/__overlay__/synaptics_tcm@0:synaptics,irq-gpio:0\0/fragment@5/__overlay__/synaptics_tcm@0:synaptics,reset-gpio:0\0/fragment@7:target:0\0/fragment@9:target:0\0/fragment@10:target:0\0/fragment@13:target:0\0/fragment@14/__overlay__:mt6370,intr_gpio:0\0/fragment@15/__overlay__:mt6370pd,intr_gpio:0\0/fragment@16:target:0\0/fragment@18/__overlay__/aw87359@58:reset-gpio:0\0/fragment@20:target:0\0/fragment@21/__overlay__:fpreset-gpio:0\0/fragment@21/__overlay__:fpint-gpio:0\0/fragment@21/__overlay__:fppower-gpio:0\0/fragment@25/__overlay__/alsps@51:interrupt-parent:0\0/fragment@36/__overlay__:GPIO_SIM2_SIO:0\0/fragment@36/__overlay__:GPIO_SIM2_SRST:0\0/fragment@36/__overlay__:GPIO_SIM2_SCLK:0\0/fragment@36/__overlay__:GPIO_SIM1_SCLK:0\0/fragment@36/__overlay__:GPIO_SIM1_SRST:0\0/fragment@36/__overlay__:GPIO_SIM1_SIO:0\0/fragment@36/__overlay__:GPIO_SIM2_HOT_PLUG:0\0/fragment@36/__overlay__:GPIO_SIM1_HOT_PLUG:0\0/fragment@36/__overlay__:GPIO_FDD_BAND_SUPPORT_DETECT_2ND_PIN:0\0/fragment@36/__overlay__:GPIO_FDD_BAND_SUPPORT_DETECT_1ST_PIN:0\0/fragment@38/__overlay__:interrupt-parent:0\0/fragment@38/__overlay__:deb-gpios:0\0/fragment@39/__overlay__:interrupt-parent:0\0/fragment@40/__overlay__:interrupt-parent:0\0/fragment@40/__overlay__:deb-gpios:0\0/fragment@41/__overlay__:interrupt-parent:0\0/fragment@42/__overlay__:interrupt-parent:0\0/fragment@42/__overlay__:deb-gpios:0\0/fragment@43/__overlay__:interrupt-parent:0\0/fragment@44/__overlay__:interrupt-parent:0\0/fragment@45/__overlay__:interrupt-parent:0\0/fragment@46/__overlay__:interrupt-parent:0\0/fragment@47/__overlay__:interrupt-parent:0\0/fragment@48/__overlay__:interrupt-parent:0\0/fragment@49/__overlay__:interrupt-parent:0\0/fragment@50/__overlay__:interrupt-parent:0\0/fragment@63:target:0";
		pmic_clock_buffer_ctrl = "/fragment@23:target:0";
		rt9465_slave_chr = "/fragment@43:target:0";
		scp = "/fragment@2:target:0";
		smart_pa = "/fragment@50:target:0";
		spi0 = "/fragment@19:target:0";
		spi5 = "/fragment@5:target:0";
		subpmic_pmu_eint = "/fragment@44:target:0";
		tcpc_pd = "/fragment@45:target:0";
		touch = "/fragment@3:target:0\0/fragment@39:target:0\0/fragment@61:target:0";
	};

	__local_fixups__ {

		fragment@11 {

			__overlay__ {
				pinctrl-0 = <0x00>;
				pinctrl-1 = <0x00>;
				pinctrl-2 = <0x00>;
				pinctrl-3 = <0x00>;
			};
		};

		fragment@12 {

			__overlay__ {
				pinctrl-0 = <0x00>;
				pinctrl-1 = <0x00>;
			};
		};

		fragment@17 {

			__overlay__ {
				pinctrl-0 = <0x00>;
			};
		};

		fragment@21 {

			__overlay__ {
				pinctrl-0 = <0x00>;
				pinctrl-1 = <0x00>;
				pinctrl-2 = <0x00>;
				pinctrl-3 = <0x00>;
				pinctrl-4 = <0x00>;
				pinctrl-5 = <0x00>;
				pinctrl-6 = <0x00>;
				pinctrl-7 = <0x00>;
			};
		};

		fragment@3 {

			__overlay__ {
				pinctrl-0 = <0x00>;
				pinctrl-1 = <0x00>;
				pinctrl-2 = <0x00>;
				pinctrl-3 = <0x00>;
				pinctrl-4 = <0x00>;
				pinctrl-5 = <0x00>;
			};
		};

		fragment@6 {

			__overlay__ {
				pinctrl-0 = <0x00>;
				pinctrl-1 = <0x00>;
				pinctrl-2 = <0x00>;
				pinctrl-3 = <0x00>;
				pinctrl-4 = <0x00>;
				pinctrl-5 = <0x00>;
			};
		};

		fragment@64 {

			__overlay__ {
				pinctrl-0 = <0x00>;
				pinctrl-1 = <0x00>;
				pinctrl-10 = <0x00>;
				pinctrl-11 = <0x00>;
				pinctrl-12 = <0x00>;
				pinctrl-13 = <0x00>;
				pinctrl-14 = <0x00>;
				pinctrl-15 = <0x00>;
				pinctrl-16 = <0x00>;
				pinctrl-17 = <0x00>;
				pinctrl-18 = <0x00>;
				pinctrl-19 = <0x00>;
				pinctrl-2 = <0x00>;
				pinctrl-20 = <0x00>;
				pinctrl-21 = <0x00>;
				pinctrl-22 = <0x00>;
				pinctrl-23 = <0x00>;
				pinctrl-24 = <0x00>;
				pinctrl-25 = <0x00>;
				pinctrl-26 = <0x00>;
				pinctrl-27 = <0x00>;
				pinctrl-28 = <0x00>;
				pinctrl-29 = <0x00>;
				pinctrl-3 = <0x00>;
				pinctrl-30 = <0x00>;
				pinctrl-31 = <0x00>;
				pinctrl-32 = <0x00>;
				pinctrl-33 = <0x00>;
				pinctrl-34 = <0x00>;
				pinctrl-35 = <0x00>;
				pinctrl-36 = <0x00>;
				pinctrl-37 = <0x00>;
				pinctrl-38 = <0x00>;
				pinctrl-39 = <0x00>;
				pinctrl-4 = <0x00>;
				pinctrl-40 = <0x00>;
				pinctrl-41 = <0x00>;
				pinctrl-42 = <0x00>;
				pinctrl-43 = <0x00>;
				pinctrl-44 = <0x00>;
				pinctrl-5 = <0x00>;
				pinctrl-6 = <0x00>;
				pinctrl-7 = <0x00>;
				pinctrl-8 = <0x00>;
				pinctrl-9 = <0x00>;
			};
		};

		fragment@8 {

			__overlay__ {
				pinctrl-0 = <0x00>;
				pinctrl-1 = <0x00>;
				pinctrl-10 = <0x00>;
				pinctrl-11 = <0x00>;
				pinctrl-2 = <0x00>;
				pinctrl-3 = <0x00>;
				pinctrl-4 = <0x00>;
				pinctrl-5 = <0x00>;
				pinctrl-6 = <0x00>;
				pinctrl-7 = <0x00>;
				pinctrl-8 = <0x00>;
				pinctrl-9 = <0x00>;
			};
		};
	};

	__symbols__ {
		accdet_audio_mode = "/fragment@7/__overlay__/accdetaudio@0";
		accdet_micswitch_high = "/fragment@7/__overlay__/micswitchhigh@0";
		accdet_micswitch_low = "/fragment@7/__overlay__/micswitchlow@0";
		accdet_pins_default = "/fragment@7/__overlay__/accdetdefault";
		accdet_pins_eint_as_int = "/fragment@7/__overlay__/accdeteint@0";
		accdet_usb_mode = "/fragment@7/__overlay__/accdetusb@0";
		alsps_mtk = "/fragment@25/__overlay__/alsps@51";
		aud_clk_mosi_off = "/fragment@9/__overlay__/aud_clk_mosi_off";
		aud_clk_mosi_on = "/fragment@9/__overlay__/aud_clk_mosi_on";
		aud_dat_miso_off = "/fragment@9/__overlay__/aud_dat_miso_off";
		aud_dat_miso_on = "/fragment@9/__overlay__/aud_dat_miso_on";
		aud_dat_mosi_off = "/fragment@9/__overlay__/aud_dat_mosi_off";
		aud_dat_mosi_on = "/fragment@9/__overlay__/aud_dat_mosi_on";
		aud_pins_smartpa_off = "/fragment@9/__overlay__/aud_pins_smartpa_off";
		aud_pins_smartpa_on = "/fragment@9/__overlay__/aud_pins_smartpa_on";
		barometer_mtk = "/fragment@25/__overlay__/barometer@77";
		betterlife_int_default = "/fragment@20/__overlay__/fp_int_def";
		betterlife_power_1v8_high = "/fragment@20/__overlay__/fp_power_1v8_high";
		betterlife_power_1v8_low = "/fragment@20/__overlay__/fp_power_1v8_low";
		betterlife_power_2v8_high = "/fragment@20/__overlay__/fp_power_2v8_high";
		betterlife_power_2v8_low = "/fragment@20/__overlay__/fp_power_2v8_low";
		betterlife_reset_output_high = "/fragment@20/__overlay__/fp_rst_high";
		betterlife_reset_output_low = "/fragment@20/__overlay__/fp_rst_low";
		betterlife_spi_default = "/fragment@20/__overlay__/fp_spi";
		camera_main_af_mtk = "/fragment@26/__overlay__/camera_main_af@72";
		camera_main_eeprom_mtk = "/fragment@26/__overlay__/camera_main_eeprom@50";
		camera_main_mtk = "/fragment@26/__overlay__/camera_main@1a";
		camera_main_three_af_mtk = "/fragment@28/__overlay__/camera_main_three_af@74";
		camera_main_three_mtk = "/fragment@28/__overlay__/camera_main_three@58";
		camera_main_two_af_mtk = "/fragment@28/__overlay__/camera_main_two_af@72";
		camera_main_two_eeprom_mtk = "/fragment@28/__overlay__/camera_main_two_eeprom@51";
		camera_main_two_mtk = "/fragment@28/__overlay__/camera_main_two@10";
		camera_pins_cam0_mclk_2ma = "/fragment@63/__overlay__/camera_pins_cam0_mclk_2ma";
		camera_pins_cam0_mclk_4ma = "/fragment@63/__overlay__/camera_pins_cam0_mclk_4ma";
		camera_pins_cam0_mclk_6ma = "/fragment@63/__overlay__/camera_pins_cam0_mclk_6ma";
		camera_pins_cam0_mclk_8ma = "/fragment@63/__overlay__/camera_pins_cam0_mclk_8ma";
		camera_pins_cam0_mclk_off = "/fragment@63/__overlay__/camera_pins_cam0_mclk_off";
		camera_pins_cam0_pnd_0 = "/fragment@63/__overlay__/cam0@2";
		camera_pins_cam0_pnd_1 = "/fragment@63/__overlay__/cam0@3";
		camera_pins_cam0_rst_0 = "/fragment@63/__overlay__/cam0@0";
		camera_pins_cam0_rst_1 = "/fragment@63/__overlay__/cam0@1";
		camera_pins_cam1_mclk_2ma = "/fragment@63/__overlay__/camera_pins_cam1_mclk_2ma";
		camera_pins_cam1_mclk_4ma = "/fragment@63/__overlay__/camera_pins_cam1_mclk_4ma";
		camera_pins_cam1_mclk_6ma = "/fragment@63/__overlay__/camera_pins_cam1_mclk_6ma";
		camera_pins_cam1_mclk_8ma = "/fragment@63/__overlay__/camera_pins_cam1_mclk_8ma";
		camera_pins_cam1_mclk_off = "/fragment@63/__overlay__/camera_pins_cam1_mclk_off";
		camera_pins_cam1_pnd_0 = "/fragment@63/__overlay__/cam1@2";
		camera_pins_cam1_pnd_1 = "/fragment@63/__overlay__/cam1@3";
		camera_pins_cam1_rst_0 = "/fragment@63/__overlay__/cam1@0";
		camera_pins_cam1_rst_1 = "/fragment@63/__overlay__/cam1@1";
		camera_pins_cam2_mclk_2ma = "/fragment@63/__overlay__/camera_pins_cam2_mclk_2ma";
		camera_pins_cam2_mclk_4ma = "/fragment@63/__overlay__/camera_pins_cam2_mclk_4ma";
		camera_pins_cam2_mclk_6ma = "/fragment@63/__overlay__/camera_pins_cam2_mclk_6ma";
		camera_pins_cam2_mclk_8ma = "/fragment@63/__overlay__/camera_pins_cam2_mclk_8ma";
		camera_pins_cam2_mclk_off = "/fragment@63/__overlay__/camera_pins_cam2_mclk_off";
		camera_pins_cam2_pnd_0 = "/fragment@63/__overlay__/cam2@2";
		camera_pins_cam2_pnd_1 = "/fragment@63/__overlay__/cam2@3";
		camera_pins_cam2_rst_0 = "/fragment@63/__overlay__/cam2@0";
		camera_pins_cam2_rst_1 = "/fragment@63/__overlay__/cam2@1";
		camera_pins_cam2_vcama_0 = "/fragment@63/__overlay__/cam2@vcam2";
		camera_pins_cam2_vcama_1 = "/fragment@63/__overlay__/cam2@vcam3";
		camera_pins_cam2_vcamd_0 = "/fragment@63/__overlay__/cam2@vcam0";
		camera_pins_cam2_vcamd_1 = "/fragment@63/__overlay__/cam2@vcam1";
		camera_pins_cam3_mclk_2ma = "/fragment@63/__overlay__/camera_pins_cam3_mclk_2ma";
		camera_pins_cam3_mclk_4ma = "/fragment@63/__overlay__/camera_pins_cam3_mclk_4ma";
		camera_pins_cam3_mclk_6ma = "/fragment@63/__overlay__/camera_pins_cam3_mclk_6ma";
		camera_pins_cam3_mclk_8ma = "/fragment@63/__overlay__/camera_pins_cam3_mclk_8ma";
		camera_pins_cam3_mclk_off = "/fragment@63/__overlay__/camera_pins_cam3_mclk_off";
		camera_pins_cam3_pnd_0 = "/fragment@63/__overlay__/cam3@2";
		camera_pins_cam3_pnd_1 = "/fragment@63/__overlay__/cam3@3";
		camera_pins_cam3_rst_0 = "/fragment@63/__overlay__/cam3@0";
		camera_pins_cam3_rst_1 = "/fragment@63/__overlay__/cam3@1";
		camera_pins_cam3_vcama_0 = "/fragment@63/__overlay__/cam3@vcam2";
		camera_pins_cam3_vcama_1 = "/fragment@63/__overlay__/cam3@vcam3";
		camera_pins_cam3_vcamd_0 = "/fragment@63/__overlay__/cam3@vcam0";
		camera_pins_cam3_vcamd_1 = "/fragment@63/__overlay__/cam3@vcam1";
		camera_pins_default = "/fragment@63/__overlay__/camdefault";
		camera_sub_eeprom_mtk = "/fragment@28/__overlay__/camera_sub_eeprom@54";
		camera_sub_mtk = "/fragment@28/__overlay__/camera_sub@35";
		cap_touch_mtk = "/fragment@24/__overlay__/cap_touch@70";
		ccu_sensor_i2c_2_hw_mtk = "/fragment@26/__overlay__/ccu_sensor_i2c_2_hw@33";
		ccu_sensor_i2c_4_hw_mtk = "/fragment@28/__overlay__/ccu_sensor_i2c_4_hw@36";
		consys_pins_default = "/fragment@10/__overlay__/consys_default";
		ctp_pins_default = "/fragment@4/__overlay__/eint0default";
		ctp_pins_eint_as_int = "/fragment@4/__overlay__/eint@0";
		ctp_pins_eint_output0 = "/fragment@4/__overlay__/eintoutput0";
		ctp_pins_eint_output1 = "/fragment@4/__overlay__/eintoutput1";
		ctp_pins_rst_output0 = "/fragment@4/__overlay__/rstoutput0";
		ctp_pins_rst_output1 = "/fragment@4/__overlay__/rstoutput1";
		gpslna_pins_init = "/fragment@10/__overlay__/gpslna@0";
		gpslna_pins_oh = "/fragment@10/__overlay__/gpslna@1";
		gpslna_pins_ol = "/fragment@10/__overlay__/gpslna@2";
		irtx_gpio_led_default = "/fragment@13/__overlay__/irtx_gpio_led_def@gpio90";
		irtx_gpio_led_set = "/fragment@13/__overlay__/irtx_gpio_led_set@gpio90";
		led0 = "/fragment@1/__overlay__/led@0";
		led1 = "/fragment@1/__overlay__/led@1";
		led2 = "/fragment@1/__overlay__/led@2";
		led3 = "/fragment@1/__overlay__/led@3";
		led4 = "/fragment@1/__overlay__/led@4";
		led5 = "/fragment@1/__overlay__/led@5";
		led6 = "/fragment@1/__overlay__/led@6";
		msensor_mtk = "/fragment@25/__overlay__/msensor@0c";
		mtkfb_pins_lcm_dsi_te = "/fragment@16/__overlay__/lcm_dsi_te";
		nfc_mtk = "/fragment@27/__overlay__/nfc@08";
		subpmic_pmu_mtk = "/fragment@29/__overlay__/subpmic_pmu@34";
		usb_c_pinctrl = "/fragment@1/__overlay__/usb_c_pinctrl";
		usb_type_c_mtk = "/fragment@29/__overlay__/usb_type_c@4e";
		vibrator0 = "/fragment@1/__overlay__/vibrator@0";
		vow_clk_miso_off = "/fragment@9/__overlay__/vow_clk_miso_off";
		vow_clk_miso_on = "/fragment@9/__overlay__/vow_clk_miso_on";
		vow_dat_miso_off = "/fragment@9/__overlay__/vow_dat_miso_off";
		vow_dat_miso_on = "/fragment@9/__overlay__/vow_dat_miso_on";
	};

	fragment@0 {
		target = <0xffffffff>;

		__overlay__ {
			atag,videolfb-fb_base_h = <0x00>;
			atag,videolfb-fb_base_l = "^`P";
			atag,videolfb-fps = <0x1770>;
			atag,videolfb-islcm_inited = <0x00>;
			atag,videolfb-islcmfound = <0x01>;
			atag,videolfb-lcmname = "nt35595_fhd_dsi_cmd_truly_nt50358_drv";
			atag,videolfb-vramSize = <0x17bb000>;
		};
	};

	fragment@1 {
		target = <0xffffffff>;

		__overlay__ {

			led@0 {
				compatible = "mediatek,red";
				data = <0x01>;
				led_mode = <0x00>;
				phandle = <0x55>;
				pwm_config = <0x00 0x00 0x00 0x00 0x00>;
			};

			led@1 {
				compatible = "mediatek,green";
				data = <0x01>;
				led_mode = <0x00>;
				phandle = <0x56>;
				pwm_config = <0x00 0x00 0x00 0x00 0x00>;
			};

			led@2 {
				compatible = "mediatek,blue";
				data = <0x01>;
				led_mode = <0x00>;
				phandle = <0x57>;
				pwm_config = <0x00 0x00 0x00 0x00 0x00>;
			};

			led@3 {
				compatible = "mediatek,jogball-backlight";
				data = <0x01>;
				led_mode = <0x00>;
				phandle = <0x58>;
				pwm_config = <0x00 0x00 0x00 0x00 0x00>;
			};

			led@4 {
				compatible = "mediatek,keyboard-backlight";
				data = <0x01>;
				led_mode = <0x00>;
				phandle = <0x59>;
				pwm_config = <0x00 0x00 0x00 0x00 0x00>;
			};

			led@5 {
				compatible = "mediatek,button-backlight";
				data = <0x01>;
				led_mode = <0x00>;
				phandle = <0x5a>;
				pwm_config = <0x00 0x00 0x00 0x00 0x00>;
			};

			led@6 {
				compatible = "mediatek,lcd-backlight";
				data = <0x01>;
				led_mode = <0x05>;
				phandle = <0x5b>;
				pwm_config = <0x00 0x01 0x00 0x00 0x00>;
			};

			usb_c_pinctrl {
				compatible = "mediatek,usb_c_pinctrl";
				phandle = <0x5d>;
			};

			vibrator@0 {
				compatible = "mediatek,vibrator";
				phandle = <0x5c>;
				vib_limit = <0x09>;
				vib_timer = <0x19>;
				vib_vol = <0x09>;
			};
		};
	};

	fragment@10 {
		target = <0xffffffff>;

		__overlay__ {

			consys_default {
				phandle = <0x19>;
			};

			gpslna@0 {
				phandle = <0x1a>;

				pins_cmd_dat {
					bias-disable;
					output-low;
					pinmux = <0x9b00>;
					slew-rate = <0x00>;
				};
			};

			gpslna@1 {
				phandle = <0x1b>;

				pins_cmd_dat {
					output-high;
					pinmux = <0x9b00>;
					slew-rate = <0x01>;
				};
			};

			gpslna@2 {
				phandle = <0x1c>;

				pins_cmd_dat {
					output-low;
					pinmux = <0x9b00>;
					slew-rate = <0x01>;
				};
			};
		};
	};

	fragment@11 {
		target = <0xffffffff>;

		__overlay__ {
			pinctrl-0 = <0x19>;
			pinctrl-1 = <0x1a>;
			pinctrl-2 = <0x1b>;
			pinctrl-3 = <0x1c>;
			pinctrl-names = "default\0gps_lna_state_init\0gps_lna_state_oh\0gps_lna_state_ol";
			status = "okay";
		};
	};

	fragment@12 {
		target = <0xffffffff>;

		__overlay__ {
			pinctrl-0 = <0x1d>;
			pinctrl-1 = <0x1e>;
			pinctrl-names = "irtx_gpio_led_default\0irtx_gpio_led_set";
			status = "okay";
		};
	};

	fragment@13 {
		target = <0xffffffff>;

		__overlay__ {

			irtx_gpio_led_def@gpio90 {
				phandle = <0x1d>;

				pins_cmd_dat {
					bias-disable;
					input-schmitt-enable = <0x00>;
					output-low;
					pinmux = <0x5a00>;
					slew-rate = <0x01>;
				};
			};

			irtx_gpio_led_set@gpio90 {
				phandle = <0x1e>;

				pins_cmd_dat {
					output-high;
					pinmux = <0x5a01>;
					slew-rate = <0x01>;
				};
			};
		};
	};

	fragment@14 {
		target = <0xffffffff>;

		__overlay__ {
			mt6370,intr_gpio = <0xffffffff 0x0a 0x00>;
			mt6370,intr_gpio_num = <0x0a>;
		};
	};

	fragment@15 {
		target = <0xffffffff>;

		__overlay__ {
			mt6370pd,intr_gpio = <0xffffffff 0x29 0x00>;
			mt6370pd,intr_gpio_num = <0x29>;
		};
	};

	fragment@16 {
		target = <0xffffffff>;

		__overlay__ {

			lcm_dsi_te {
				phandle = <0x1f>;

				pins_cmd_dat {
					pinmux = <0x2c01>;
				};
			};
		};
	};

	fragment@17 {
		target = <0xffffffff>;

		__overlay__ {
			pinctrl-0 = <0x1f>;
			pinctrl-names = "mode_te_te";
			status = "okay";
		};
	};

	fragment@18 {
		target = <0xffffffff>;

		__overlay__ {

			aw87359@58 {
				compatible = "awinic,aw87359_pa";
				reg = <0x58>;
				reset-gpio = <0xffffffff 0x99 0x00>;
				status = "okay";
			};
		};
	};

	fragment@19 {
		target = <0xffffffff>;

		__overlay__ {
			#address-cells = <0x01>;
			#size-cells = <0x00>;

			betterlife-spi@betterlife-spi {
				compatible = "betterlife,spi";
				reg = <0x00>;
				spi-max-frequency = <0x10000000>;
				status = "okay";
			};
		};
	};

	fragment@2 {
		target = <0xffffffff>;

		__overlay__ {
			core_1 = "enable";
			scp_sramSize = <0x80000>;
		};
	};

	fragment@20 {
		target = <0xffffffff>;

		__overlay__ {

			fp_int_def {
				phandle = <0x23>;

				pins_cmd_dat {
					bias-pull-down = <0x00>;
					pinmux = <0xa600>;
					slew-rate = <0x00>;
				};
			};

			fp_power_1v8_high {
				phandle = <0x26>;
			};

			fp_power_1v8_low {
				phandle = <0x27>;
			};

			fp_power_2v8_high {
				phandle = <0x24>;

				pins_cmd_dat {
					output-high;
					pinmux = <0x1600>;
					slew-rate = <0x01>;
				};
			};

			fp_power_2v8_low {
				phandle = <0x25>;

				pins_cmd_dat {
					output-low;
					pinmux = <0x1600>;
					slew-rate = <0x01>;
				};
			};

			fp_rst_high {
				phandle = <0x21>;

				pins_cmd_dat {
					output-high;
					pinmux = <0xa000>;
					slew-rate = <0x01>;
				};
			};

			fp_rst_low {
				phandle = <0x22>;

				pins_cmd_dat {
					output-low;
					pinmux = <0xa000>;
					slew-rate = <0x01>;
				};
			};

			fp_spi {
				phandle = <0x20>;
			};
		};
	};

	fragment@21 {
		target = <0xffffffff>;

		__overlay__ {
			fpint-gpio = <0xffffffff 0xa6 0x00>;
			fppower-gpio = <0xffffffff 0x16 0x00>;
			fpreset-gpio = <0xffffffff 0xa0 0x00>;
			pinctrl-0 = <0x20>;
			pinctrl-1 = <0x21>;
			pinctrl-2 = <0x22>;
			pinctrl-3 = <0x23>;
			pinctrl-4 = <0x24>;
			pinctrl-5 = <0x25>;
			pinctrl-6 = <0x26>;
			pinctrl-7 = <0x27>;
			pinctrl-names = "spi_default\0reset-output-high\0reset-output-low\0int_default\0power_2v8_high\0power_2v8_low\0power_1v8_high\0power_1v8_low";
			status = "okay";
		};
	};

	fragment@22 {
		target = <0xffffffff>;

		__overlay__ {

			adc_channel@ {
				compatible = "mediatek,adc_channel";
				mediatek,adc_fdd_rf_params_dynamic_custom_ch = <0x02>;
				mediatek,temperature0 = <0x00>;
				mediatek,temperature1 = <0x01>;
				status = "okay";
			};
		};
	};

	fragment@23 {
		target = <0xffffffff>;

		__overlay__ {
			mediatek,clkbuf-config = <0x02 0x01 0x01 0x02 0x00 0x00 0x01>;
			mediatek,clkbuf-driving-current = <0xffffffff 0xffffffff 0xffffffff 0xffffffff 0xffffffff 0xffffffff 0xffffffff>;
			mediatek,clkbuf-quantity = <0x07>;
			status = "okay";
		};
	};

	fragment@24 {
		target = <0xffffffff>;

		__overlay__ {
			#address-cells = <0x01>;
			#size-cells = <0x00>;
			clock-frequency = <0x61a80>;
			mediatek,use-open-drain;

			cap_touch@70 {
				compatible = "mediatek,cap_touch";
				phandle = <0x5e>;
				reg = <0x70>;
				status = "okay";
			};
		};
	};

	fragment@25 {
		target = <0xffffffff>;

		__overlay__ {
			#address-cells = <0x01>;
			#size-cells = <0x00>;
			clock-frequency = <0x61a80>;
			mediatek,use-open-drain;

			alsps@51 {
				compatible = "mediatek,alsps";
				interrupt-parent = <0xffffffff>;
				interrupts = <0x06 0x08 0x06 0x00>;
				phandle = <0x60>;
				reg = <0x51>;
				status = "okay";
			};

			barometer@77 {
				compatible = "mediatek,barometer";
				phandle = <0x61>;
				reg = <0x77>;
				status = "okay";
			};

			msensor@0c {
				compatible = "mediatek,msensor";
				phandle = <0x5f>;
				reg = <0x0c>;
				status = "okay";
			};
		};
	};

	fragment@26 {
		target = <0xffffffff>;

		__overlay__ {
			#address-cells = <0x01>;
			#size-cells = <0x00>;
			clock-frequency = <0x61a80>;
			mediatek,use-open-drain;

			camera_main@1a {
				compatible = "mediatek,camera_main";
				phandle = <0x62>;
				reg = <0x1a>;
				status = "okay";
			};

			camera_main_af@72 {
				compatible = "mediatek,camera_main_af";
				phandle = <0x63>;
				reg = <0x72>;
				status = "okay";
			};

			camera_main_eeprom@50 {
				compatible = "mediatek,camera_main_eeprom";
				phandle = <0x64>;
				reg = <0x50>;
				status = "okay";
			};

			ccu_sensor_i2c_2_hw@33 {
				compatible = "mediatek,ccu_sensor_i2c_2_hw";
				phandle = <0x65>;
				reg = <0x33>;
				status = "okay";
			};
		};
	};

	fragment@27 {
		target = <0xffffffff>;

		__overlay__ {
			#address-cells = <0x01>;
			#size-cells = <0x00>;
			clock-frequency = <0x61a80>;
			mediatek,use-open-drain;

			nfc@08 {
				compatible = "mediatek,nfc";
				phandle = <0x66>;
				reg = <0x08>;
				status = "okay";
			};
		};
	};

	fragment@28 {
		target = <0xffffffff>;

		__overlay__ {
			#address-cells = <0x01>;
			#size-cells = <0x00>;
			clock-frequency = <0x61a80>;
			mediatek,use-open-drain;

			camera_main_three@58 {
				compatible = "mediatek,camera_main_three";
				phandle = <0x6c>;
				reg = <0x58>;
				status = "okay";
			};

			camera_main_three_af@74 {
				compatible = "mediatek,camera_main_three_af";
				phandle = <0x6d>;
				reg = <0x74>;
				status = "okay";
			};

			camera_main_two@10 {
				compatible = "mediatek,camera_main_two";
				phandle = <0x67>;
				reg = <0x10>;
				status = "okay";
			};

			camera_main_two_af@72 {
				compatible = "mediatek,camera_main_two_af";
				phandle = <0x68>;
				reg = <0x72>;
				status = "okay";
			};

			camera_main_two_eeprom@51 {
				compatible = "mediatek,camera_main_two_eeprom";
				phandle = <0x69>;
				reg = <0x51>;
				status = "okay";
			};

			camera_sub@35 {
				compatible = "mediatek,camera_sub";
				phandle = <0x6a>;
				reg = <0x35>;
				status = "okay";
			};

			camera_sub_eeprom@54 {
				compatible = "mediatek,camera_sub_eeprom";
				phandle = <0x6b>;
				reg = <0x54>;
				status = "okay";
			};

			ccu_sensor_i2c_4_hw@36 {
				compatible = "mediatek,ccu_sensor_i2c_4_hw";
				phandle = <0x6e>;
				reg = <0x36>;
				status = "okay";
			};
		};
	};

	fragment@29 {
		target = <0xffffffff>;

		__overlay__ {
			#address-cells = <0x01>;
			#size-cells = <0x00>;
			clock-frequency = <0x33e140>;
			mediatek,use-push-pull;

			subpmic_pmu@34 {
				compatible = "mediatek,subpmic_pmu";
				phandle = <0x70>;
				reg = <0x34>;
				status = "okay";
			};

			usb_type_c@4e {
				compatible = "mediatek,usb_type_c";
				phandle = <0x6f>;
				reg = <0x4e>;
				status = "okay";
			};
		};
	};

	fragment@3 {
		target = <0xffffffff>;

		__overlay__ {
			pinctrl-0 = <0x01>;
			pinctrl-1 = <0x02>;
			pinctrl-2 = <0x03>;
			pinctrl-3 = <0x04>;
			pinctrl-4 = <0x05>;
			pinctrl-5 = <0x06>;
			pinctrl-names = "default\0state_eint_as_int\0state_eint_output0\0state_eint_output1\0state_rst_output0\0state_rst_output1";
			status = "okay";
			tpd-filter-custom-prameters = <0x00 0x00 0x00 0x00 0x00 0x00 0x00 0x00 0x00 0x00 0x00 0x00>;
			tpd-filter-custom-speed = <0x00 0x00 0x00>;
			tpd-filter-enable = <0x01>;
			tpd-filter-pixel-density = <0x92>;
			tpd-key-dim-local = <0x5a 0x373 0x64 0x28 0xe6 0x373 0x64 0x28 0x172 0x373 0x64 0x28 0x00 0x00 0x00 0x00>;
			tpd-key-local = <0x8b 0xac 0x9e 0x00>;
			tpd-key-num = <0x03>;
			tpd-max-touch-num = <0x05>;
			tpd-resolution = <0x438 0x924>;
			use-tpd-button = <0x00>;
		};
	};

	fragment@30 {
		target = <0xffffffff>;

		__overlay__ {
			#address-cells = <0x01>;
			#size-cells = <0x00>;
			clock-frequency = <0x61a80>;
			mediatek,use-open-drain;
		};
	};

	fragment@31 {
		target = <0xffffffff>;

		__overlay__ {
			#address-cells = <0x01>;
			#size-cells = <0x00>;
			clock-frequency = <0x61a80>;
			mediatek,use-open-drain;
		};
	};

	fragment@32 {
		target = <0xffffffff>;

		__overlay__ {
			#address-cells = <0x01>;
			#size-cells = <0x00>;
			clock-frequency = <0x61a80>;
			mediatek,use-open-drain;
		};
	};

	fragment@33 {
		target = <0xffffffff>;

		__overlay__ {
			#address-cells = <0x01>;
			#size-cells = <0x00>;
			clock-frequency = <0x61a80>;
			mediatek,use-open-drain;
		};
	};

	fragment@34 {
		target = <0xffffffff>;

		__overlay__ {
			#address-cells = <0x01>;
			#size-cells = <0x00>;
			clock-frequency = <0x61a80>;
			mediatek,use-open-drain;
		};
	};

	fragment@35 {
		target = <0xffffffff>;

		__overlay__ {
			#address-cells = <0x01>;
			#size-cells = <0x00>;
			clock-frequency = <0x61a80>;
			mediatek,use-open-drain;
		};
	};

	fragment@36 {
		target = <0xffffffff>;

		__overlay__ {
			GPIO_FDD_BAND_SUPPORT_DETECT_1ST_PIN = <0xffffffff 0x4e 0x00>;
			GPIO_FDD_BAND_SUPPORT_DETECT_2ND_PIN = <0xffffffff 0x36 0x00>;
			GPIO_SIM1_HOT_PLUG = <0xffffffff 0x2f 0x00>;
			GPIO_SIM1_SCLK = <0xffffffff 0x26 0x00>;
			GPIO_SIM1_SIO = <0xffffffff 0x28 0x00>;
			GPIO_SIM1_SRST = <0xffffffff 0x27 0x00>;
			GPIO_SIM2_HOT_PLUG = <0xffffffff 0x2e 0x00>;
			GPIO_SIM2_SCLK = <0xffffffff 0x25 0x00>;
			GPIO_SIM2_SIO = <0xffffffff 0x23 0x00>;
			GPIO_SIM2_SRST = <0xffffffff 0x24 0x00>;
		};
	};

	fragment@37 {
		target = <0xffffffff>;

		__overlay__ {
			gpio_init_default = <0x00 0x00 0x00 0x00 0x01 0x01 0x01 0x01 0x00 0x00 0x00 0x01 0x01 0x01 0x02 0x00 0x01 0x00 0x01 0x00 0x01 0x03 0x00 0x00 0x00 0x01 0x01 0x01 0x04 0x00 0x00 0x00 0x01 0x01 0x00 0x05 0x00 0x00 0x00 0x01 0x00 0x00 0x06 0x00 0x00 0x00 0x01 0x01 0x00 0x07 0x00 0x00 0x00 0x01 0x01 0x00 0x08 0x00 0x01 0x00 0x00 0x00 0x00 0x09 0x00 0x01 0x00 0x00 0x00 0x00 0x0a 0x00 0x00 0x00 0x01 0x01 0x00 0x0b 0x03 0x00 0x00 0x01 0x01 0x00 0x0c 0x03 0x00 0x00 0x01 0x01 0x00 0x0d 0x02 0x00 0x00 0x01 0x00 0x00 0x0e 0x02 0x01 0x00 0x00 0x00 0x00 0x0f 0x02 0x01 0x00 0x01 0x00 0x00 0x10 0x02 0x01 0x00 0x00 0x00 0x00 0x11 0x00 0x01 0x00 0x00 0x00 0x00 0x12 0x00 0x01 0x00 0x00 0x00 0x00 0x13 0x00 0x01 0x00 0x00 0x00 0x00 0x14 0x00 0x01 0x01 0x00 0x00 0x00 0x15 0x00 0x01 0x01 0x00 0x00 0x00 0x16 0x00 0x01 0x01 0x00 0x00 0x00 0x17 0x00 0x00 0x00 0x01 0x00 0x00 0x18 0x00 0x01 0x01 0x00 0x00 0x00 0x19 0x00 0x01 0x00 0x00 0x00 0x00 0x1a 0x00 0x00 0x00 0x01 0x00 0x00 0x1b 0x00 0x00 0x00 0x01 0x00 0x00 0x1c 0x00 0x00 0x00 0x01 0x00 0x00 0x1d 0x01 0x01 0x00 0x00 0x00 0x00 0x1e 0x01 0x00 0x00 0x01 0x01 0x00 0x1f 0x01 0x00 0x00 0x01 0x01 0x00 0x20 0x01 0x00 0x00 0x01 0x01 0x00 0x21 0x01 0x00 0x00 0x01 0x01 0x00 0x22 0x01 0x00 0x00 0x01 0x01 0x00 0x23 0x01 0x00 0x00 0x01 0x01 0x00 0x24 0x01 0x01 0x00 0x00 0x00 0x00 0x25 0x01 0x01 0x00 0x00 0x00 0x00 0x26 0x01 0x01 0x00 0x00 0x00 0x00 0x27 0x01 0x01 0x00 0x00 0x00 0x00 0x28 0x01 0x00 0x00 0x01 0x01 0x00 0x29 0x00 0x00 0x00 0x01 0x01 0x00 0x2a 0x00 0x01 0x00 0x00 0x00 0x00 0x2b 0x01 0x01 0x00 0x00 0x00 0x00 0x2c 0x01 0x00 0x00 0x01 0x00 0x00 0x2d 0x00 0x01 0x01 0x00 0x00 0x00 0x2e 0x01 0x00 0x00 0x01 0x01 0x00 0x2f 0x01 0x00 0x00 0x01 0x01 0x00 0x30 0x01 0x00 0x00 0x01 0x01 0x00 0x31 0x01 0x00 0x00 0x01 0x01 0x00 0x32 0x01 0x00 0x00 0x01 0x01 0x00 0x33 0x01 0x00 0x00 0x01 0x01 0x00 0x34 0x01 0x01 0x00 0x01 0x00 0x00 0x35 0x01 0x01 0x00 0x01 0x00 0x00 0x36 0x00 0x00 0x00 0x01 0x00 0x00 0x37 0x01 0x01 0x00 0x01 0x00 0x00 0x38 0x01 0x01 0x00 0x01 0x00 0x00 0x39 0x01 0x01 0x00 0x01 0x00 0x00 0x3a 0x00 0x00 0x00 0x01 0x00 0x00 0x3b 0x01 0x00 0x00 0x01 0x00 0x00 0x3c 0x01 0x00 0x00 0x01 0x00 0x00 0x3d 0x01 0x00 0x00 0x01 0x00 0x00 0x3e 0x01 0x00 0x00 0x01 0x00 0x00 0x3f 0x01 0x00 0x00 0x01 0x00 0x00 0x40 0x01 0x00 0x00 0x01 0x00 0x00 0x41 0x02 0x00 0x00 0x01 0x00 0x00 0x42 0x02 0x00 0x00 0x01 0x00 0x00 0x43 0x01 0x00 0x00 0x01 0x00 0x00 0x44 0x01 0x00 0x00 0x01 0x00 0x00 0x45 0x00 0x01 0x01 0x00 0x00 0x00 0x46 0x00 0x00 0x00 0x01 0x00 0x00 0x47 0x01 0x01 0x00 0x01 0x00 0x00 0x48 0x01 0x01 0x00 0x01 0x00 0x00 0x49 0x01 0x01 0x00 0x01 0x00 0x00 0x4a 0x01 0x01 0x00 0x01 0x00 0x00 0x4b 0x01 0x01 0x00 0x01 0x00 0x00 0x4c 0x01 0x01 0x00 0x01 0x00 0x00 0x4d 0x01 0x01 0x00 0x01 0x00 0x00 0x4e 0x00 0x00 0x00 0x01 0x00 0x00 0x4f 0x01 0x00 0x00 0x01 0x00 0x00 0x50 0x01 0x00 0x00 0x01 0x00 0x00 0x51 0x01 0x00 0x00 0x01 0x01 0x00 0x52 0x01 0x00 0x00 0x01 0x01 0x00 0x53 0x01 0x00 0x00 0x01 0x01 0x00 0x54 0x01 0x00 0x00 0x01 0x01 0x00 0x55 0x01 0x00 0x00 0x01 0x00 0x00 0x56 0x01 0x01 0x01 0x00 0x00 0x00 0x57 0x01 0x01 0x00 0x00 0x00 0x00 0x58 0x01 0x01 0x00 0x00 0x00 0x00 0x59 0x01 0x00 0x00 0x01 0x00 0x00 0x5a 0x01 0x01 0x00 0x00 0x00 0x00 0x5b 0x00 0x01 0x00 0x00 0x00 0x00 0x5c 0x00 0x01 0x00 0x00 0x00 0x00 0x5d 0x01 0x00 0x00 0x01 0x01 0x00 0x5e 0x01 0x00 0x00 0x01 0x01 0x00 0x5f 0x01 0x00 0x00 0x01 0x01 0x00 0x60 0x01 0x01 0x00 0x00 0x00 0x00 0x61 0x00 0x01 0x00 0x00 0x00 0x00 0x62 0x00 0x01 0x00 0x00 0x00 0x00 0x63 0x00 0x01 0x00 0x00 0x00 0x00 0x64 0x00 0x01 0x00 0x00 0x00 0x00 0x65 0x00 0x01 0x01 0x00 0x00 0x00 0x66 0x00 0x01 0x01 0x00 0x00 0x00 0x67 0x01 0x00 0x00 0x01 0x01 0x00 0x68 0x01 0x00 0x00 0x01 0x01 0x00 0x69 0x01 0x00 0x00 0x01 0x01 0x00 0x6a 0x01 0x00 0x00 0x01 0x01 0x00 0x6b 0x00 0x01 0x00 0x00 0x00 0x00 0x6c 0x00 0x01 0x00 0x00 0x00 0x00 0x6d 0x00 0x01 0x01 0x00 0x00 0x00 0x6e 0x07 0x00 0x00 0x01 0x01 0x00 0x6f 0x00 0x00 0x00 0x00 0x00 0x00 0x70 0x07 0x01 0x00 0x00 0x00 0x00 0x71 0x00 0x00 0x00 0x01 0x00 0x00 0x72 0x00 0x00 0x00 0x01 0x00 0x00 0x73 0x00 0x00 0x00 0x01 0x00 0x00 0x74 0x00 0x00 0x00 0x01 0x00 0x00 0x75 0x00 0x00 0x00 0x01 0x00 0x00 0x76 0x00 0x00 0x00 0x01 0x00 0x00 0x77 0x00 0x00 0x00 0x01 0x00 0x00 0x78 0x00 0x00 0x00 0x01 0x00 0x00 0x79 0x00 0x00 0x00 0x01 0x00 0x00 0x7a 0x01 0x00 0x00 0x01 0x01 0x00 0x7b 0x01 0x00 0x00 0x01 0x01 0x00 0x7c 0x01 0x01 0x00 0x00 0x00 0x00 0x7d 0x01 0x00 0x00 0x01 0x01 0x00 0x7e 0x01 0x00 0x00 0x01 0x01 0x00 0x7f 0x01 0x00 0x00 0x01 0x01 0x00 0x80 0x01 0x00 0x00 0x01 0x01 0x00 0x81 0x01 0x00 0x00 0x01 0x01 0x00 0x82 0x01 0x00 0x00 0x01 0x01 0x00 0x83 0x01 0x00 0x00 0x01 0x00 0x00 0x84 0x01 0x00 0x00 0x01 0x01 0x00 0x85 0x01 0x01 0x01 0x00 0x00 0x00 0x86 0x01 0x00 0x00 0x01 0x00 0x01 0x87 0x01 0x01 0x00 0x00 0x00 0x00 0x88 0x01 0x01 0x00 0x01 0x00 0x00 0x89 0x01 0x01 0x00 0x01 0x00 0x00 0x8a 0x01 0x01 0x00 0x00 0x00 0x00 0x8b 0x01 0x01 0x00 0x01 0x00 0x00 0x8c 0x01 0x00 0x00 0x00 0x00 0x00 0x8d 0x01 0x00 0x00 0x00 0x00 0x00 0x8e 0x01 0x00 0x00 0x00 0x00 0x00 0x8f 0x01 0x00 0x00 0x00 0x00 0x00 0x90 0x01 0x00 0x00 0x01 0x00 0x00 0x91 0x01 0x01 0x01 0x00 0x00 0x00 0x92 0x01 0x00 0x00 0x01 0x00 0x00 0x93 0x01 0x01 0x00 0x00 0x00 0x00 0x94 0x01 0x01 0x00 0x00 0x00 0x00 0x95 0x01 0x01 0x00 0x00 0x00 0x00 0x96 0x00 0x00 0x00 0x01 0x00 0x00 0x97 0x00 0x01 0x00 0x00 0x00 0x00 0x98 0x00 0x01 0x00 0x00 0x00 0x00 0x99 0x00 0x01 0x01 0x00 0x00 0x00 0x9a 0x01 0x01 0x00 0x00 0x00 0x00 0x9b 0x00 0x01 0x00 0x00 0x00 0x00 0x9c 0x00 0x00 0x00 0x01 0x00 0x00 0x9d 0x00 0x00 0x00 0x01 0x00 0x00 0x9e 0x00 0x00 0x00 0x01 0x00 0x00 0x9f 0x00 0x00 0x00 0x01 0x00 0x00 0xa0 0x00 0x01 0x00 0x00 0x00 0x00 0xa1 0x02 0x00 0x00 0x01 0x00 0x00 0xa2 0x02 0x01 0x01 0x00 0x00 0x00 0xa3 0x02 0x01 0x00 0x00 0x00 0x00 0xa4 0x02 0x01 0x00 0x00 0x00 0x00 0xa5 0x00 0x01 0x01 0x00 0x00 0x00 0xa6 0x00 0x00 0x00 0x00 0x00 0x00 0xa7 0x01 0x01 0x00 0x01 0x00 0x00 0xa8 0x01 0x01 0x00 0x01 0x00 0x00 0xa9 0x00 0x00 0x00 0x01 0x00 0x00 0xaa 0x02 0x01 0x00 0x01 0x00 0x00 0xab 0x02 0x01 0x00 0x01 0x00 0x00 0xac 0x02 0x01 0x00 0x01 0x00 0x00 0xad 0x00 0x00 0x00 0x01 0x00 0x00 0xae 0x02 0x00 0x00 0x01 0x00 0x00 0xaf 0x00 0x01 0x00 0x00 0x00 0x00 0xb0 0x00 0x00 0x00 0x01 0x00 0x00 0xb1 0x00 0x00 0x00 0x01 0x00 0x00 0xb2 0x00 0x01 0x00 0x00 0x00 0x00 0xb3 0x00 0x00 0x00 0x01 0x00 0x00 0xb4 0x00 0x00 0x00 0x01 0x00 0x00 0xb5 0x00 0x00 0x00 0x01 0x00 0x00 0xb6 0x00 0x00 0x00 0x01 0x00 0x00 0xb7 0x00 0x00 0x00 0x01 0x00 0x00 0xb8 0x00 0x00 0x00 0x01 0x00 0x00 0xb9 0x00 0x00 0x00 0x01 0x00 0x00 0xba 0x00 0x00 0x00 0x01 0x00 0x00 0xbb 0x00 0x00 0x00 0x01 0x00 0x00 0xbc 0x00 0x00 0x00 0x01 0x00 0x00 0xbd 0x00 0x00 0x00 0x01 0x00 0x00 0xbe 0x00 0x00 0x00 0x01 0x00 0x00 0xbf 0x00 0x00 0x00 0x01 0x00 0x00>;
		};
	};

	fragment@38 {
		target = <0xffffffff>;

		__overlay__ {
			deb-gpios = <0xffffffff 0x00 0x00>;
			debounce = <0x7d000>;
			interrupt-parent = <0xffffffff>;
			interrupts = <0x00 0x08 0x00 0x00>;
			status = "okay";
		};
	};

	fragment@39 {
		target = <0xffffffff>;

		__overlay__ {
			interrupt-parent = <0xffffffff>;
			interrupts = <0x01 0x02 0x01 0x00>;
			status = "okay";
		};
	};

	fragment@4 {
		target = <0xffffffff>;

		__overlay__ {

			eint0default {
				phandle = <0x01>;
			};

			eint@0 {
				phandle = <0x02>;

				pins_cmd_dat {
					bias-disable;
					pinmux = <0x100>;
					slew-rate = <0x00>;
				};
			};

			eintoutput0 {
				phandle = <0x03>;

				pins_cmd_dat {
					output-low;
					pinmux = <0x100>;
					slew-rate = <0x01>;
				};
			};

			eintoutput1 {
				phandle = <0x04>;

				pins_cmd_dat {
					output-high;
					pinmux = <0x100>;
					slew-rate = <0x01>;
				};
			};

			rstoutput0 {
				phandle = <0x05>;

				pins_cmd_dat {
					output-low;
					pinmux = <0x1400>;
					slew-rate = <0x01>;
				};
			};

			rstoutput1 {
				phandle = <0x06>;

				pins_cmd_dat {
					output-high;
					pinmux = <0x1400>;
					slew-rate = <0x01>;
				};
			};
		};
	};

	fragment@40 {
		target = <0xffffffff>;

		__overlay__ {
			deb-gpios = <0xffffffff 0x03 0x00>;
			debounce = <0x3e800>;
			interrupt-parent = <0xffffffff>;
			interrupts = <0x03 0x04 0x03 0x00>;
			status = "okay";
		};
	};

	fragment@41 {
		target = <0xffffffff>;

		__overlay__ {
			interrupt-parent = <0xffffffff>;
			interrupts = <0x04 0x08 0x04 0x00>;
			status = "okay";
		};
	};

	fragment@42 {
		target = <0xffffffff>;

		__overlay__ {
			deb-gpios = <0xffffffff 0x07 0x00>;
			debounce = <0x3e800>;
			interrupt-parent = <0xffffffff>;
			interrupts = <0x07 0x08 0x07 0x00>;
			status = "okay";
		};
	};

	fragment@43 {
		target = <0xffffffff>;

		__overlay__ {
			interrupt-parent = <0xffffffff>;
			interrupts = <0x09 0x08 0x09 0x00>;
			status = "okay";
		};
	};

	fragment@44 {
		target = <0xffffffff>;

		__overlay__ {
			interrupt-parent = <0xffffffff>;
			interrupts = <0x0a 0x08 0x0a 0x00>;
			status = "okay";
		};
	};

	fragment@45 {
		target = <0xffffffff>;

		__overlay__ {
			interrupt-parent = <0xffffffff>;
			interrupts = <0x29 0x08 0x29 0x00>;
			status = "okay";
		};
	};

	fragment@46 {
		target = <0xffffffff>;

		__overlay__ {
			interrupt-parent = <0xffffffff>;
			interrupts = <0x2c 0x01 0x2c 0x01>;
			status = "okay";
		};
	};

	fragment@47 {
		target = <0xffffffff>;

		__overlay__ {
			interrupt-parent = <0xffffffff>;
			interrupts = <0x46 0x04 0x46 0x00>;
			status = "okay";
		};
	};

	fragment@48 {
		target = <0xffffffff>;

		__overlay__ {
			interrupt-parent = <0xffffffff>;
			interrupts = <0xa6 0x01 0xa6 0x00>;
			status = "okay";
		};
	};

	fragment@49 {
		target = <0xffffffff>;

		__overlay__ {
			interrupt-parent = <0xffffffff>;
			interrupts = <0xb6 0x04 0xbe 0x00>;
			status = "okay";
		};
	};

	fragment@5 {
		target = <0xffffffff>;

		__overlay__ {
			#address-cells = <0x01>;
			#size-cells = <0x00>;
			status = "okay";

			synaptics_tcm@0 {
				compatible = "synaptics,tcm-spi";
				interrupt-parent = <0xffffffff>;
				interrupts = <0x01 0x2008>;
				reg = <0x00>;
				spi-max-frequency = <0x7a1200>;
				status = "okay";
				synaptics,block-delay-us = <0x00>;
				synaptics,byte-delay-us = <0x00>;
				synaptics,irq-gpio = <0xffffffff 0x01 0x2008>;
				synaptics,irq-on-state = <0x00>;
				synaptics,power-delay-ms = <0xc8>;
				synaptics,reset-active-ms = <0x14>;
				synaptics,reset-delay-ms = <0xc8>;
				synaptics,reset-gpio = <0xffffffff 0x14 0x00>;
				synaptics,reset-on-state = <0x00>;
				synaptics,spi-mode = <0x03>;
				synaptics,ubl-byte-delay-us = <0x00>;
				synaptics,ubl-max-freq = <0x186a0>;
			};
		};
	};

	fragment@50 {
		target = <0xffffffff>;

		__overlay__ {
			interrupt-parent = <0xffffffff>;
			interrupts = <0xba 0x08 0xad 0x00>;
			status = "okay";
		};
	};

	fragment@51 {
		target = <0xffffffff>;

		__overlay__ {
			compatible = "mediatek,md1_sim1_hot_plug_eint-eint";
			debounce = <0x00 0x186a0>;
			dedicated = <0x00 0x00>;
			interrupts = <0x00 0x08>;
			sockettype = <0x00 0x00>;
			src_pin = <0x00 0x01>;
			status = "okay";
		};
	};

	fragment@52 {
		target = <0xffffffff>;

		__overlay__ {
			compatible = "mediatek,md1_sim2_hot_plug_eint-eint";
			debounce = <0x01 0x186a0>;
			dedicated = <0x01 0x00>;
			interrupts = <0x01 0x08>;
			sockettype = <0x01 0x00>;
			src_pin = <0x01 0x02>;
			status = "okay";
		};
	};

	fragment@53 {
		target = <0xffffffff>;

		__overlay__ {
			regulator-default-on = <0x01>;
			regulator-name = "vcama1";
			status = "okay";
		};
	};

	fragment@54 {
		target = <0xffffffff>;

		__overlay__ {
			regulator-default-on = <0x01>;
			regulator-name = "vcama2";
			status = "okay";
		};
	};

	fragment@55 {
		target = <0xffffffff>;

		__overlay__ {
			regulator-default-on = <0x01>;
			regulator-name = "vsim1";
			status = "okay";
		};
	};

	fragment@56 {
		target = <0xffffffff>;

		__overlay__ {
			regulator-default-on = <0x01>;
			regulator-name = "vsim2";
			status = "okay";
		};
	};

	fragment@57 {
		target = <0xffffffff>;

		__overlay__ {
			regulator-default-on = <0x01>;
			regulator-name = "vcamd";
			status = "okay";
		};
	};

	fragment@58 {
		target = <0xffffffff>;

		__overlay__ {
			regulator-default-on = <0x01>;
			regulator-name = "vcamio";
			status = "okay";
		};
	};

	fragment@59 {
		target = <0xffffffff>;

		__overlay__ {
			regulator-default-on = <0x01>;
			regulator-name = "vldo28";
			status = "okay";
		};
	};

	fragment@6 {
		target = <0xffffffff>;

		__overlay__ {
			accdet-mic-mode = <0x01>;
			accdet-mic-vol = <0x06>;
			accdet-plugout-debounce = <0x01>;
			headset-eint-level-pol = <0x08>;
			headset-four-key-threshold = <0x00 0x3a 0x79 0xc0 0x190>;
			headset-mode-setting = <0x500 0x500 0x01 0x1f0 0x800 0x800 0x20 0x44>;
			headset-three-key-threshold = <0x00 0x3c 0xc8 0x190>;
			headset-three-key-threshold-CDD = <0x00 0x79 0xc0 0x258>;
			pinctrl-0 = <0x07>;
			pinctrl-1 = <0x08>;
			pinctrl-2 = <0x09>;
			pinctrl-3 = <0x0a>;
			pinctrl-4 = <0x0b>;
			pinctrl-5 = <0x0c>;
			pinctrl-names = "default\0state_eint_as_int\0state_audio_mode\0state_usb_mode\0state_micswitch_high\0state_micswitch_low";
			status = "okay";
		};
	};

	fragment@60 {
		target = <0xffffffff>;

		__overlay__ {
			status = "okay";
			vcama-supply = <0xffffffff>;
			vcama_sub-supply = <0xffffffff>;
			vcamaf-supply = <0xffffffff>;
			vcamaf_main2-supply = <0xffffffff>;
			vcamaf_sub-supply = <0xffffffff>;
			vcamd-supply = <0xffffffff>;
			vcamd_sub-supply = <0xffffffff>;
			vcamio-supply = <0xffffffff>;
			vcamio_main2-supply = <0xffffffff>;
			vcamio_sub-supply = <0xffffffff>;
		};
	};

	fragment@61 {
		target = <0xffffffff>;

		__overlay__ {
			status = "okay";
			vtouch-supply = <0xffffffff>;
		};
	};

	fragment@62 {
		target = <0xffffffff>;

		__overlay__ {
			mediatek,kpd-hw-dl-key0 = <0x01>;
			mediatek,kpd-hw-dl-key1 = <0x00>;
			mediatek,kpd-hw-dl-key2 = <0x08>;
			mediatek,kpd-hw-factory-key = <0x00>;
			mediatek,kpd-hw-init-map = <0x72 0x73 0x00 0x00 0x00 0x00 0x00 0x00 0x00 0x00 0x00 0x00 0x00 0x00 0x00 0x00 0x00 0x00 0x00 0x00 0x00 0x00 0x00 0x00 0x00 0x00 0x00 0x00 0x00 0x00 0x00 0x00 0x00 0x00 0x00 0x00 0x00 0x00 0x00 0x00 0x00 0x00 0x00 0x00 0x00 0x00 0x00 0x00 0x00 0x00 0x00 0x00 0x00 0x00 0x00 0x00 0x00 0x00 0x00 0x00 0x00 0x00 0x00 0x00 0x00 0x00 0x00 0x00 0x00 0x00 0x00 0x00>;
			mediatek,kpd-hw-map-num = <0x48>;
			mediatek,kpd-hw-pwrkey = <0x08>;
			mediatek,kpd-hw-recovery-key = <0x01>;
			mediatek,kpd-key-debounce = <0x400>;
			mediatek,kpd-pwkey-gpio-din = <0x00>;
			mediatek,kpd-pwrkey-eint-gpio = <0x00>;
			mediatek,kpd-sw-pwrkey = <0x74>;
			mediatek,kpd-use-extend-type = <0x00>;
			status = "okay";
		};
	};

	fragment@63 {
		target = <0xffffffff>;

		__overlay__ {

			cam0@0 {
				phandle = <0x29>;

				pins_cmd1_dat {
					output-low;
					pinmux = <0x1500>;
					slew-rate = <0x01>;
				};

				pins_cmd2_dat {
					output-low;
					pinmux = <0x5c00>;
					slew-rate = <0x01>;
				};

				pins_cmd_dat {
					output-low;
					pinmux = <0x6500>;
					slew-rate = <0x01>;
				};
			};

			cam0@1 {
				phandle = <0x2a>;

				pins_cmd1_dat {
					output-high;
					pinmux = <0x1500>;
					slew-rate = <0x01>;
				};

				pins_cmd2_dat {
					output-high;
					pinmux = <0x5c00>;
					slew-rate = <0x01>;
				};

				pins_cmd_dat {
					output-high;
					pinmux = <0x6500>;
					slew-rate = <0x01>;
				};
			};

			cam0@2 {
				phandle = <0x2b>;

				pins_cmd1_dat {
					output-high;
					pinmux = <0x900>;
					slew-rate = <0x01>;
				};

				pins_cmd_dat {
					output-low;
					pinmux = <0x6100>;
					slew-rate = <0x01>;
				};
			};

			cam0@3 {
				phandle = <0x2c>;

				pins_cmd1_dat {
					output-low;
					pinmux = <0x900>;
					slew-rate = <0x01>;
				};

				pins_cmd_dat {
					output-high;
					pinmux = <0x6100>;
					slew-rate = <0x01>;
				};
			};

			cam1@0 {
				phandle = <0x2d>;

				pins_cmd_dat {
					output-low;
					pinmux = <0x6600>;
					slew-rate = <0x01>;
				};
			};

			cam1@1 {
				phandle = <0x2e>;

				pins_cmd_dat {
					output-high;
					pinmux = <0x6600>;
					slew-rate = <0x01>;
				};
			};

			cam1@2 {
				phandle = <0x2f>;

				pins_cmd_dat {
					output-low;
					pinmux = <0x6200>;
					slew-rate = <0x01>;
				};
			};

			cam1@3 {
				phandle = <0x30>;

				pins_cmd_dat {
					output-high;
					pinmux = <0x6200>;
					slew-rate = <0x01>;
				};
			};

			cam2@0 {
				phandle = <0x31>;

				pins_cmd1_dat {
					output-low;
					pinmux = <0x800>;
					slew-rate = <0x01>;
				};

				pins_cmd2_dat {
					output-high;
					pinmux = <0x200>;
					slew-rate = <0x01>;
				};

				pins_cmd_dat {
					output-low;
					pinmux = <0x1800>;
					slew-rate = <0x01>;
				};
			};

			cam2@1 {
				phandle = <0x32>;

				pins_cmd1_dat {
					output-low;
					pinmux = <0x800>;
					slew-rate = <0x01>;
				};

				pins_cmd2_dat {
					output-low;
					pinmux = <0x200>;
					slew-rate = <0x01>;
				};

				pins_cmd_dat {
					output-high;
					pinmux = <0x1800>;
					slew-rate = <0x01>;
				};
			};

			cam2@2 {
				phandle = <0x33>;

				pins_cmd_dat {
					output-low;
					pinmux = <0x1900>;
					slew-rate = <0x01>;
				};
			};

			cam2@3 {
				phandle = <0x34>;

				pins_cmd_dat {
					output-high;
					pinmux = <0x1900>;
					slew-rate = <0x01>;
				};
			};

			cam2@vcam0 {
				phandle = <0x39>;

				pins_cmd_dat {
					output-low;
					pinmux = <0x5b00>;
					slew-rate = <0x01>;
				};
			};

			cam2@vcam1 {
				phandle = <0x3a>;

				pins_cmd_dat {
					output-high;
					pinmux = <0x5b00>;
					slew-rate = <0x01>;
				};
			};

			cam2@vcam2 {
				phandle = <0x3b>;

				pins_cmd_dat {
					output-low;
					pinmux = <0x5c00>;
					slew-rate = <0x01>;
				};
			};

			cam2@vcam3 {
				phandle = <0x3c>;

				pins_cmd_dat {
					output-high;
					pinmux = <0x5c00>;
					slew-rate = <0x01>;
				};
			};

			cam3@0 {
				phandle = <0x35>;

				pins_cmd1_dat {
					output-high;
					pinmux = <0x800>;
					slew-rate = <0x01>;
				};

				pins_cmd2_dat {
					output-high;
					pinmux = <0x200>;
					slew-rate = <0x01>;
				};

				pins_cmd_dat {
					output-low;
					pinmux = <0x6d00>;
					slew-rate = <0x01>;
				};
			};

			cam3@1 {
				phandle = <0x36>;

				pins_cmd1_dat {
					output-high;
					pinmux = <0x800>;
					slew-rate = <0x01>;
				};

				pins_cmd2_dat {
					output-low;
					pinmux = <0x200>;
					slew-rate = <0x01>;
				};

				pins_cmd_dat {
					output-high;
					pinmux = <0x6d00>;
					slew-rate = <0x01>;
				};
			};

			cam3@2 {
				phandle = <0x37>;

				pins_cmd_dat {
					output-low;
					pinmux = <0x6b00>;
					slew-rate = <0x01>;
				};
			};

			cam3@3 {
				phandle = <0x38>;

				pins_cmd_dat {
					output-high;
					pinmux = <0x6b00>;
					slew-rate = <0x01>;
				};
			};

			cam3@vcam0 {
				phandle = <0x3d>;

				pins_cmd_dat {
					output-low;
					pinmux = <0xb200>;
					slew-rate = <0x01>;
				};
			};

			cam3@vcam1 {
				phandle = <0x3e>;

				pins_cmd_dat {
					output-high;
					pinmux = <0xb200>;
					slew-rate = <0x01>;
				};
			};

			cam3@vcam2 {
				phandle = <0x3f>;

				pins_cmd_dat {
					output-low;
					pinmux = <0x1100>;
					slew-rate = <0x01>;
				};
			};

			cam3@vcam3 {
				phandle = <0x40>;

				pins_cmd_dat {
					output-high;
					pinmux = <0x1100>;
					slew-rate = <0x01>;
				};
			};

			camdefault {
				phandle = <0x28>;
			};

			camera_pins_cam0_mclk_2ma {
				phandle = <0x42>;

				pins_cmd_dat {
					drive-strength = <0x00>;
					pinmux = <0x6301>;
				};
			};

			camera_pins_cam0_mclk_4ma {
				phandle = <0x43>;

				pins_cmd_dat {
					drive-strength = <0x01>;
					pinmux = <0x6301>;
				};
			};

			camera_pins_cam0_mclk_6ma {
				phandle = <0x44>;

				pins_cmd_dat {
					drive-strength = <0x02>;
					pinmux = <0x6301>;
				};
			};

			camera_pins_cam0_mclk_8ma {
				phandle = <0x45>;

				pins_cmd_dat {
					drive-strength = <0x03>;
					pinmux = <0x6301>;
				};
			};

			camera_pins_cam0_mclk_off {
				phandle = <0x41>;

				pins_cmd_dat {
					drive-strength = <0x01>;
					pinmux = <0x6300>;
				};
			};

			camera_pins_cam1_mclk_2ma {
				phandle = <0x47>;

				pins_cmd_dat {
					drive-strength = <0x00>;
					pinmux = <0x6401>;
				};
			};

			camera_pins_cam1_mclk_4ma {
				phandle = <0x48>;

				pins_cmd_dat {
					drive-strength = <0x01>;
					pinmux = <0x6401>;
				};
			};

			camera_pins_cam1_mclk_6ma {
				phandle = <0x49>;

				pins_cmd_dat {
					drive-strength = <0x02>;
					pinmux = <0x6401>;
				};
			};

			camera_pins_cam1_mclk_8ma {
				phandle = <0x4a>;

				pins_cmd_dat {
					drive-strength = <0x03>;
					pinmux = <0x6401>;
				};
			};

			camera_pins_cam1_mclk_off {
				phandle = <0x46>;

				pins_cmd_dat {
					drive-strength = <0x01>;
					pinmux = <0x6400>;
				};
			};

			camera_pins_cam2_mclk_2ma {
				phandle = <0x4c>;

				pins_cmd_dat {
					drive-strength = <0x00>;
					pinmux = <0x6c01>;
				};
			};

			camera_pins_cam2_mclk_4ma {
				phandle = <0x4d>;

				pins_cmd_dat {
					drive-strength = <0x01>;
					pinmux = <0x6c01>;
				};
			};

			camera_pins_cam2_mclk_6ma {
				phandle = <0x4e>;

				pins_cmd_dat {
					drive-strength = <0x02>;
					pinmux = <0x6c01>;
				};
			};

			camera_pins_cam2_mclk_8ma {
				phandle = <0x4f>;

				pins_cmd_dat {
					drive-strength = <0x03>;
					pinmux = <0x6c01>;
				};
			};

			camera_pins_cam2_mclk_off {
				phandle = <0x4b>;

				pins_cmd_dat {
					drive-strength = <0x01>;
					pinmux = <0x6c00>;
				};
			};

			camera_pins_cam3_mclk_2ma {
				phandle = <0x51>;

				pins_cmd_dat {
					drive-strength = <0x00>;
					pinmux = <0x6c01>;
				};
			};

			camera_pins_cam3_mclk_4ma {
				phandle = <0x52>;

				pins_cmd_dat {
					drive-strength = <0x01>;
					pinmux = <0x6c01>;
				};
			};

			camera_pins_cam3_mclk_6ma {
				phandle = <0x53>;

				pins_cmd_dat {
					drive-strength = <0x02>;
					pinmux = <0x6c01>;
				};
			};

			camera_pins_cam3_mclk_8ma {
				phandle = <0x54>;

				pins_cmd_dat {
					drive-strength = <0x03>;
					pinmux = <0x6c01>;
				};
			};

			camera_pins_cam3_mclk_off {
				phandle = <0x50>;

				pins_cmd_dat {
					drive-strength = <0x01>;
					pinmux = <0x6c00>;
				};
			};
		};
	};

	fragment@64 {
		target = <0xffffffff>;

		__overlay__ {
			cam0_vcama-supply = <0xffffffff>;
			cam0_vcamd-supply = <0xffffffff>;
			cam0_vcamio-supply = <0xffffffff>;
			cam1_vcama-supply = <0xffffffff>;
			cam1_vcamd-supply = <0xffffffff>;
			cam1_vcamio-supply = <0xffffffff>;
			cam2_vcamio-supply = <0xffffffff>;
			cam3_vcamio-supply = <0xffffffff>;
			pinctrl-0 = <0x28>;
			pinctrl-1 = <0x29>;
			pinctrl-10 = <0x32>;
			pinctrl-11 = <0x33>;
			pinctrl-12 = <0x34>;
			pinctrl-13 = <0x35>;
			pinctrl-14 = <0x36>;
			pinctrl-15 = <0x37>;
			pinctrl-16 = <0x38>;
			pinctrl-17 = <0x39>;
			pinctrl-18 = <0x3a>;
			pinctrl-19 = <0x3b>;
			pinctrl-2 = <0x2a>;
			pinctrl-20 = <0x3c>;
			pinctrl-21 = <0x3d>;
			pinctrl-22 = <0x3e>;
			pinctrl-23 = <0x3f>;
			pinctrl-24 = <0x40>;
			pinctrl-25 = <0x41>;
			pinctrl-26 = <0x42>;
			pinctrl-27 = <0x43>;
			pinctrl-28 = <0x44>;
			pinctrl-29 = <0x45>;
			pinctrl-3 = <0x2b>;
			pinctrl-30 = <0x46>;
			pinctrl-31 = <0x47>;
			pinctrl-32 = <0x48>;
			pinctrl-33 = <0x49>;
			pinctrl-34 = <0x4a>;
			pinctrl-35 = <0x4b>;
			pinctrl-36 = <0x4c>;
			pinctrl-37 = <0x4d>;
			pinctrl-38 = <0x4e>;
			pinctrl-39 = <0x4f>;
			pinctrl-4 = <0x2c>;
			pinctrl-40 = <0x50>;
			pinctrl-41 = <0x51>;
			pinctrl-42 = <0x52>;
			pinctrl-43 = <0x53>;
			pinctrl-44 = <0x54>;
			pinctrl-5 = <0x2d>;
			pinctrl-6 = <0x2e>;
			pinctrl-7 = <0x2f>;
			pinctrl-8 = <0x30>;
			pinctrl-9 = <0x31>;
			pinctrl-names = "default\0cam0_rst0\0cam0_rst1\0cam0_pnd0\0cam0_pnd1\0cam1_rst0\0cam1_rst1\0cam1_pnd0\0cam1_pnd1\0cam2_rst0\0cam2_rst1\0cam2_pnd0\0cam2_pnd1\0cam3_rst0\0cam3_rst1\0cam3_pnd0\0cam3_pnd1\0cam2_ldo_vcamd_0\0cam2_ldo_vcamd_1\0cam2_ldo_vcama_0\0cam2_ldo_vcama_1\0cam3_ldo_vcamd_0\0cam3_ldo_vcamd_1\0cam3_ldo_vcama_0\0cam3_ldo_vcama_1\0cam0_mclk_off\0cam0_mclk_2mA\0cam0_mclk_4mA\0cam0_mclk_6mA\0cam0_mclk_8mA\0cam1_mclk_off\0cam1_mclk_2mA\0cam1_mclk_4mA\0cam1_mclk_6mA\0cam1_mclk_8mA\0cam2_mclk_off\0cam2_mclk_2mA\0cam2_mclk_4mA\0cam2_mclk_6mA\0cam2_mclk_8mA\0cam3_mclk_off\0cam3_mclk_2mA\0cam3_mclk_4mA\0cam3_mclk_6mA\0cam3_mclk_8mA";
			status = "okay";
		};
	};

	fragment@7 {
		target = <0xffffffff>;

		__overlay__ {

			accdetaudio@0 {
				phandle = <0x09>;

				pins_cmd_dat {
					output-high;
					pinmux = <0x1300>;
					slew-rate = <0x01>;
				};
			};

			accdetdefault {
				phandle = <0x07>;
			};

			accdeteint@0 {
				phandle = <0x08>;

				pins_cmd_dat {
					bias-disable;
					pinmux = <0x700>;
					slew-rate = <0x00>;
				};
			};

			accdetusb@0 {
				phandle = <0x0a>;

				pins_cmd_dat {
					output-low;
					pinmux = <0x1300>;
					slew-rate = <0x01>;
				};
			};

			micswitchhigh@0 {
				phandle = <0x0b>;

				pins_cmd_dat {
					output-high;
					pinmux = <0x1200>;
					slew-rate = <0x01>;
				};
			};

			micswitchlow@0 {
				phandle = <0x0c>;

				pins_cmd_dat {
					output-low;
					pinmux = <0x1200>;
					slew-rate = <0x01>;
				};
			};
		};
	};

	fragment@8 {
		target = <0xffffffff>;

		__overlay__ {
			pinctrl-0 = <0x0d>;
			pinctrl-1 = <0x0e>;
			pinctrl-10 = <0x17>;
			pinctrl-11 = <0x18>;
			pinctrl-2 = <0x0f>;
			pinctrl-3 = <0x10>;
			pinctrl-4 = <0x11>;
			pinctrl-5 = <0x12>;
			pinctrl-6 = <0x13>;
			pinctrl-7 = <0x14>;
			pinctrl-8 = <0x15>;
			pinctrl-9 = <0x16>;
			pinctrl-names = "aud_clk_mosi_off\0aud_clk_mosi_on\0aud_dat_mosi_off\0aud_dat_mosi_on\0aud_dat_miso_off\0aud_dat_miso_on\0aud_smartpa_off\0aud_smartpa_on\0vow_dat_miso_off\0vow_dat_miso_on\0vow_clk_miso_off\0vow_clk_miso_on";
			status = "okay";
		};
	};

	fragment@9 {
		target = <0xffffffff>;

		__overlay__ {

			aud_clk_mosi_off {
				phandle = <0x0d>;

				pins_cmd0_dat {
					bias-pull-down;
					input-enable;
					pinmux = <0x8800>;
				};

				pins_cmd1_dat {
					bias-pull-down;
					input-enable;
					pinmux = <0x8900>;
				};
			};

			aud_clk_mosi_on {
				phandle = <0x0e>;

				pins_cmd0_dat {
					bias-disable;
					input-schmitt-enable;
					pinmux = <0x8801>;
				};

				pins_cmd1_dat {
					bias-disable;
					input-schmitt-enable;
					pinmux = <0x8901>;
				};
			};

			aud_dat_miso_off {
				phandle = <0x11>;

				pins_cmd0_dat {
					bias-disable;
					input-enable;
					pinmux = <0x8c00>;
				};

				pins_cmd1_dat {
					bias-disable;
					input-enable;
					pinmux = <0x8d00>;
				};

				pins_cmd2_dat {
					bias-disable;
					input-enable;
					pinmux = <0x8e00>;
				};

				pins_cmd3_dat {
					bias-disable;
					input-enable;
					pinmux = <0x8f00>;
				};
			};

			aud_dat_miso_on {
				phandle = <0x12>;

				pins_cmd0_dat {
					bias-disable;
					input-schmitt-enable;
					pinmux = <0x8c01>;
				};

				pins_cmd1_dat {
					bias-disable;
					input-schmitt-enable;
					pinmux = <0x8d01>;
				};

				pins_cmd2_dat {
					bias-disable;
					input-schmitt-enable;
					pinmux = <0x8e01>;
				};

				pins_cmd3_dat {
					bias-disable;
					input-schmitt-enable;
					pinmux = <0x8f01>;
				};
			};

			aud_dat_mosi_off {
				phandle = <0x0f>;

				pins_cmd0_dat {
					bias-disable;
					input-enable;
					pinmux = <0x8a00>;
				};

				pins_cmd1_dat {
					bias-pull-down;
					input-enable;
					pinmux = <0x8b00>;
				};
			};

			aud_dat_mosi_on {
				phandle = <0x10>;

				pins_cmd0_dat {
					bias-disable;
					input-schmitt-enable;
					pinmux = <0x8a01>;
				};

				pins_cmd1_dat {
					bias-disable;
					input-schmitt-enable;
					pinmux = <0x8b01>;
				};
			};

			aud_pins_smartpa_off {
				phandle = <0x13>;

				pins_cmd0_dat {
					pinmux = <0xae00>;
				};

				pins_cmd1_dat {
					pinmux = <0xaa00>;
				};

				pins_cmd2_dat {
					pinmux = <0xab00>;
				};

				pins_cmd3_dat {
					pinmux = <0xac00>;
				};
			};

			aud_pins_smartpa_on {
				phandle = <0x14>;

				pins_cmd0_dat {
					pinmux = <0xae02>;
				};

				pins_cmd1_dat {
					pinmux = <0xaa02>;
				};

				pins_cmd2_dat {
					pinmux = <0xab02>;
				};

				pins_cmd3_dat {
					pinmux = <0xac02>;
				};
			};

			vow_clk_miso_off {
				phandle = <0x17>;

				pins_cmd3_dat {
					bias-pull-down;
					input-enable;
					pinmux = <0x8f00>;
				};
			};

			vow_clk_miso_on {
				phandle = <0x18>;

				pins_cmd3_dat {
					bias-disable;
					input-schmitt-enable;
					pinmux = <0x8f04>;
				};
			};

			vow_dat_miso_off {
				phandle = <0x15>;

				pins_cmd1_dat {
					bias-pull-down;
					input-enable;
					pinmux = <0x8e00>;
				};
			};

			vow_dat_miso_on {
				phandle = <0x16>;

				pins_cmd1_dat {
					bias-disable;
					input-schmitt-enable;
					pinmux = <0x8e04>;
				};
			};
		};
	};
};
